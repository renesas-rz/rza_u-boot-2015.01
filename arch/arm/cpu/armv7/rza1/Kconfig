## arch/arm/cpu/armv7/rza1/Kconfig
```kconfig
if RZA1

choice
	prompt "Renesas RZ/A1H ARM SoCs board select"

config TARGET_YLCDRZA1H
	bool "YLCDRZA1H board"
config TARGET_STREAMIT
	bool "Stream it! board"
config TARGET_GRPEACH
	bool "GR-PEACH board"
config TARGET_GENMAI
	bool "GENMAI board"
config TARGET_RSKRZA1
	bool "RSK-RZA/1 board"

endchoice

config SYS_SOC
	default "rza1"

source "board/renesas/ylcdrza1h/Kconfig"
source "board/renesas/streamit/Kconfig"
source "board/renesas/grpeach/Kconfig"
source "board/renesas/genmai/Kconfig"
source "board/renesas/rskrza1/Kconfig"

endif
```

## board/renesas/rskrza1/Kconfig
```kconfig
if TARGET_RSKRZA1

config SYS_BOARD
	default "rskrza1"

config SYS_VENDOR
	default "renesas"

config SYS_CONFIG_NAME
	default "rskrza1"

endif
```

## board/renesas/streamit/Kconfig
```kconfig
if TARGET_STREAMIT

config SYS_BOARD
	default "streamit"

config SYS_VENDOR
	default "renesas"

config SYS_CONFIG_NAME
	default "streamit"

endif
```

## board/renesas/ylcdrza1h/Kconfig
```kconfig
if TARGET_YLCDRZA1H

config SYS_BOARD
	default "ylcdrza1h"

config SYS_VENDOR
	default "renesas"

config SYS_CONFIG_NAME
	default "ylcdrza1h"

endif
```
